## master/sdkconfig.defaults
```kconfig
# ESP-IDF Configuration defaults for Mini OS v1

# Target ESP32-S3
CONFIG_IDF_TARGET="esp32s3"

# WiFi
CONFIG_ESP_WIFI_MODE_STA=y

# ESP-NOW
CONFIG_ESP_WIFI_ESPNOW_MAX_ENCRYPT_NUM=0

# LEDC (PWM for motors and buzzer)
CONFIG_LEDC_FADE_FUNCTION_ENABLED=y

# I2C for OLED
CONFIG_I2C_MASTER_FREQUENCY=400000

# FreeRTOS
CONFIG_FREERTOS_HZ=1000

# Log level
CONFIG_LOG_DEFAULT_LEVEL_INFO=y
CONFIG_LOG_MAXIMUM_LEVEL_DEBUG=y

# Partition table
CONFIG_PARTITION_TABLE_CUSTOM=y
CONFIG_PARTITION_TABLE_CUSTOM_FILENAME="partitions.csv"

# NVS
CONFIG_NVS_ENCRYPTION=n
```
